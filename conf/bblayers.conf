## conf/bblayers.conf
```bitbake
# LAYER_CONF_VERSION is increased each time build/conf/bblayers.conf
# changes incompatibly
LCONF_VERSION = "7"

BBPATH = "${TOPDIR}"

BBFILES ?= ""

# Add your overlay location to BBLAYERS
# Make sure to have a conf/layers.conf in there
BBLAYERS = " \
  ${TOPDIR}/meta-openembedded/meta-oe \
  ${TOPDIR}/meta-openembedded/meta-gnome \
  ${TOPDIR}/meta-openembedded/meta-perl \
  ${TOPDIR}/meta-openembedded/meta-python \
  ${TOPDIR}/meta-openembedded/meta-filesystems \
  ${TOPDIR}/meta-openembedded/meta-multimedia \
  ${TOPDIR}/meta-openembedded/meta-networking \
  ${TOPDIR}/meta-openembedded/meta-xfce \
  ${TOPDIR}/meta-openembedded/meta-initramfs \
  ${TOPDIR}/meta-openembedded/meta-webserver \
  ${TOPDIR}/meta-browser \
  ${TOPDIR}/meta-qt5 \
  ${TOPDIR}/openembedded-core/meta \
"
```

## conf/local.conf
```bitbake
# additionally build a tar.gz image file (as needed for installing on SD)
#IMAGE_FSTYPES = "jffs2 tar.gz"
# speed up build by parallel building - usefull for multicore cpus
#PARALLEL_MAKE = "-j 4"
#BB_NUMBER_THREADS = "4"
# avoid multiple locales generation to speedup the build and save space
#GLIBC_GENERATE_LOCALES = "en_US.UTF-8"
# completely disable generation of locales. If building qemu fails this might help
#ENABLE_BINARY_LOCALE_GENERATION = "0"
# enable local builds for SHR apps
#require local-builds.inc

INHERIT += "rm_work"

TERMCMD = "${SCREEN_TERMCMD}"
TERMCMDRUN = "${SCREEN_TERMCMDRUN}"
```
